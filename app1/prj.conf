## CMakeLists.txt
```
cmake_minimum_required(VERSION 3.20.0)

find_package(Zephyr REQUIRED HINTS $ENV{ZEPHYR_BASE})
project(app1)

target_include_directories(app PRIVATE ../common)
target_sources(app PRIVATE src/main.c ../common/update.c)
```

## Kconfig
```
rsource "../common/Kconfig"
source "Kconfig.zephyr"
```

## prj.conf
```kconfig
CONFIG_LOG=y
CONFIG_REBOOT=y
CONFIG_DK_LIBRARY=y
CONFIG_TFM_PROFILE_TYPE_MINIMAL=y

CONFIG_MAIN_STACK_SIZE=4096
CONFIG_HEAP_MEM_POOL_SIZE=4096

# LTE
CONFIG_NRF_MODEM_LIB=y
CONFIG_LTE_LINK_CONTROL=y
CONFIG_NETWORKING=y
CONFIG_NET_SOCKETS=y
CONFIG_NET_NATIVE=n

# FOTA
CONFIG_FOTA_DOWNLOAD=y
CONFIG_DOWNLOADER=y
CONFIG_DOWNLOADER_STACK_SIZE=4096
CONFIG_DFU_TARGET=y
CONFIG_DFU_TARGET_MCUBOOT=y
CONFIG_IMG_MANAGER=y
CONFIG_STREAM_FLASH=y
CONFIG_IMG_ERASE_PROGRESSIVELY=y
CONFIG_FLASH=y
CONFIG_FLASH_MAP=y

# Secondary slots on external flash
CONFIG_SPI=y
CONFIG_SPI_NOR=y
CONFIG_SPI_NOR_SFDP_DEVICETREE=y
CONFIG_SPI_NOR_FLASH_LAYOUT_PAGE_SIZE=4096

# Sysbuild sync the MCUboot mode to default image only
CONFIG_MCUBOOT_BOOTLOADER_MODE_SWAP_USING_MOVE=y
```

## boards/nrf9151dk_nrf9151_ns.overlay
```dts
#define APP1_VIEW
#include "../../dts/partitions.dtsi"
#include <samples/cellular/nrf91_sram_partitions.dtsi>
```

## src/main.c
```c
#include <zephyr/logging/log.h>

#include "update.h"

LOG_MODULE_REGISTER(app1);

int main(void)
{
	LOG_INF("*** APP1 ***");
	update_run();
	return 0;
}
```
